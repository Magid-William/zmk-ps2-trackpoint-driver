## dts/bindings/input/zmk,input-mouse-ps2.yaml
```yaml
description: PS2 mouse configuration

compatible: "zmk,input-mouse-ps2"

properties:
  ps2-device:
    type: phandle
    required: true
    description: |
      The ps2 device the mouse should use.

  rst-gpios:
    type: phandle-array
    required: false
    description: GPIO to which the RST pin of the device is connected and on which the Power-On-Reset will be performed.

  sampling-rate:
    type: int
    description: Adjusts the sensitivity setting on trackpoint devices. The allowed values are 10, 20, 40, 60, 80, 100, 200 and the default is 100.
    enum:
      - 10
      - 20
      - 40
      - 60
      - 80
      - 100
      - 200

  scroll-mode:
    type: boolean
    description: Enables scroll wheel on mouse devices supporting the Intellimouse extension.

  disable-clicking:
    type: boolean
    description: Disables clicking. Useful when using a PS2 driver that is prone to erros in transmissions to reduce accidental clicks.

  tp-press-to-select:
    type: boolean
    description: Enables mouse clicking by pressing hard on the trackpoint. Not all trackpoints support this feature.

  tp-press-to-select-threshold:
    type: int
    description: Adjusts how sensitive the press-to-select feature is. The range is 0 - 255 and the default is 8. You can also adjust this setting at runtime without recompiling using the &mms behavior. If this setting is enabled, then the runtime behavior won't be saved into the runtime settings.

  tp-sensitivity:
    type: int
    description: Adjusts the sensitivity setting on trackpoint devices. The range is 0 - 255 and the default is 128. You can also adjust this setting at runtime without recompiling using the &mms behavior. If this setting is enabled, then the runtime behavior won't be saved into the runtime settings.

  tp-neg-inertia:
    type: int
    description: Adjusts the negative inertia setting on trackpoint devices. The range is 0 - 255 and the default is 6. You can also adjust this setting at runtime without recompiling using the &mms behavior. If this setting is enabled, then the runtime behavior won't be saved into the runtime settings.

  tp-val6-upper-speed:
    type: int
    description: Adjusts the negative value0 upper plateau speed setting on trackpoint devices. The range is 0 - 255 and the default is 97. You can also adjust this setting at runtime without recompiling using the &mms behavior. If this setting is enabled, then the runtime behavior won't be saved into the runtime settings.

  tp-x-invert:
    type: boolean
    description: Enables x axis inversion on the trackpoint. Only works with some trackpoint devices, but is properly considered by the trackpoint's acceleration features (which may or may not have an impact). Alternatively consider achieving the same effect using the `zmk,input-configs` feature.

  tp-y-invert:
    type: boolean
    description: Enables y axis inversion on the trackpoint. Only works with some trackpoint devices, but is properly considered by the trackpoint's acceleration features (which may or may not have an impact). Alternatively consider achieving the same effect using the `zmk,input-configs` feature.

  tp-xy-swap:
    type: boolean
    description: Swaps the x and y axis on the trackpoint. Only works with some trackpoint devices, but may properly considered by the trackpoint's acceleration features (which may or may not have an impact). Alternatively consider achieving the same effect using the `zmk,input-configs` feature.

  layer-toggle:
    type: int
    required: false
    description: The layer that should be toggled when the mouse is moved.

  curve-sens:
    type: int
    required: false
    description: |
      PowerCurve sensitivity multiplier (Q8.8, 255 = 1.0). Scales the whole
      curve - the "loudness" knob. Only used when curve-rate is non-zero and
      CONFIG_ZMK_INPUT_MOUSE_PS2_POWER_CURVE is enabled.

  curve-rate:
    type: int
    required: false
    default: 0
    description: |
      PowerCurve rate constant (Q8.8, e.g. 18 = 0.070). A non-zero value
      enables the curve: f(v) = start + (rate * v)^exponent where v = |(x,y)|
      per input packet (RawAccel "Power", whole mode). 0 keeps the raw stream
      (curve disabled) - the safe identity default. Only active when
      CONFIG_ZMK_INPUT_MOUSE_PS2_POWER_CURVE is enabled.

  curve-exponent:
    type: int
    required: false
    default: 256
    description: |
      PowerCurve exponent (Q8.8, 256 = 1.0). Shapes how fast the gain rises
      with speed. Only used when curve-rate is non-zero.

  curve-start:
    type: int
    required: false
    default: 256
    description: |
      PowerCurve output offset (Q8.8, 256 = 1.0) - the gain at v=0, the
      precision knob. Lower start = more attenuation of slow deltas. Only
      used when curve-rate is non-zero.
```

## src/drivers/input/Kconfig
```kconfig
# Copyright (c) 2022 The ZMK Contributors
# SPDX-License-Identifier: MIT

DT_COMPAT_ZMK_INPUT_PS2_MOUSE := zmk,input-mouse-ps2

config ZMK_INPUT_MOUSE_PS2
	bool
	default $(dt_compat_enabled,$(DT_COMPAT_ZMK_INPUT_PS2_MOUSE))
    # depends on (!ZMK_SPLIT || ZMK_SPLIT_ROLE_CENTRAL)
	select ZMK_MOUSE
    select PS2

config ZMK_INPUT_MOUSE_PS2_ENABLE_PS2_RESEND_CALLBACK
	bool "Get notifications from the underluing PS2 protocol driver when the received data is invalid and when a resend is requested from the peripheral. This helps the mouse driver to re-align its command buffer and prevent unexpected clicks and jerky movements. With the ps2-uart driver this option is not really necessary, but is very useful for the ps2-gpio driver where mis-transmissions are frequent."
	default n

if ZMK_INPUT_MOUSE_PS2

config ZMK_INPUT_MOUSE_PS2_NO_HOST_COMMANDS
	bool "Never send any host commands to the PS/2 device"
	default n
	help
	  For PS/2 devices that stream data immediately on power-up and reject
	  all host commands (e.g. certain generic trackpoints). Skips the
	  self-test/reset/identification/config handshake, never requests
	  resends, and never writes the enable/disable-reporting commands.
	  With this mode the trackpoint tuning props and the &mms behavior are
	  no-ops.

config ZMK_INPUT_MOUSE_PS2_POWER_ON_RESET_TIME
    int "The POR shall be timed to occur 600 ms ± 20 % from the time power is applied to the TrackPoint controller."
    default 600
    help
      Refer to IBM TrackPoint System Version 4.0 Engineering Specification - Section 2.1

config ZMK_INPUT_MOUSE_PS2_ENABLE_UROB_COMPAT
    bool "Makes the driver compatible with urob's zmk fork. His fork has commits that change the default zmk function definitions. This option adopts the code to make it compatible with his changes. Only enable it if you are using his fork or it will fail to compile."
	default n

config ZMK_INPUT_MOUSE_PS2_ENABLE_ERROR_MITIGATION
    bool "Tries to mitigate transmission errors. Only useful when using a PS2 driver that is prone to miscommunication like the GPIO bitbanging driver."
	default n

config ZMK_INPUT_MOUSE_PS2_REPORT_INTERVAL_MIN
    int "Minimum report rate. Use to avoid bluetooth queue overflow."
    default 0
    help
      Default minimum report interval in milliseconds.
      Slow down input reporting for hid queue over the air.

config ZMK_INPUT_MOUSE_PS2_SPEED_DIVISOR
	int "Divide all movement reports by this value (remainder accumulates)"
	default 1
	range 1 255
	help
	  Scales the pointer speed down without losing small movements: raw
	  deltas are accumulated and only whole multiples of the divisor are
	  reported, so sub-divisor motion is batched instead of dropped.
	  1 = unchanged.

config ZMK_INPUT_MOUSE_PS2_MOVEMENT_EMA_N
	int "Exponential moving average window for movement deltas"
	default 1
	range 1 32
	help
	  Dampens per-bit decode wobble from glitchy decoders (an errored bit 7
	  flips a delta between +127/-128 on near-identical bytes, which makes
	  the cursor erratic). 1 = off; 8 dampens spikes ~8x while preserving
	  slow motion.

config ZMK_INPUT_MOUSE_PS2_MEDIAN_WINDOW
	int "Median filter window for movement deltas (0, 1 = off, 3, 5)"
	default 1
	range 0 5
	help
	  Kills spike bursts from decode packet-boundary slips (which inject
	  full-scale jumps into real motion, usually in bursts of 2-3 packets).
	  5 = median of the last 5 deltas per axis; 3 = median of the last 3.

config ZMK_INPUT_MOUSE_PS2_SLEW_MAX
	int "Reject isolated deltas larger than this (0 = off)"
	default 0
	range 0 255
	help
	  Slew-rate limiter: a delta above SLEW_MAX is only reported if the
	  previous report also exceeded it, so a sustained fast flick is kept
	  while a lone spike is treated as a decode glitch.

config ZMK_INPUT_MOUSE_PS2_DELTA_MAX
	int "Reject single-packet deltas larger than this, replay last accepted (0 = off)"
	default 0
	range 0 255
	help
	  Exp77: single-packet magnitude jump filter. A spurious packet that
	  slips past the gpio-ps2 decode checks (parity/stop-bit all pass)
	  carries an absurd per-packet delta. If |delta| exceeds this threshold,
	  treat it as a jump and re-emit the last accepted value instead of the
	  spike, so the cursor holds rather than leaps. 0 = off.
	  NOTE: this also clips genuine single fast flicks (unlike SLEW_MAX,
	  which exempts sustained big deltas). Exp77: 100.

config ZMK_INPUT_MOUSE_PS2_TELEMETRY
	bool "Print 1s decode counters (input driver + ps2-gpio backend)"
	default n
	help
	  Prints a one-per-second counter line (bytes, packets, alignment
	  aborts, buffer timeouts and the ps2-gpio decode aborts) to help
	  diagnose transmission problems. Off by default.

config ZMK_INPUT_MOUSE_PS2_POWER_CURVE
	bool "RawAccel-style Power velocity curve in the input driver"
	default n
	help
	  Applies a per-sample velocity curve to the movement deltas before the
	  divisor/report stage: f(v) = start + (rate * v)^exponent with
	  v = |(x,y)| per packet. Enabled per device by setting curve-rate on
	  the zmk,input-mouse-ps2 node (0 keeps the raw stream). Compiles
	  power_curve.c, which calls float pow() at init; NEWLIB libc is known
	  to work with it.

endif # ZMK_INPUT_MOUSE_PS2
```
